## Config.in
```kconfig
comment "Emulators"
  source "$BR2_EXTERNAL_OD_CONTRIB_OPKS_PATH/package/fb-alpha/Config.in"
	source "$BR2_EXTERNAL_OD_CONTRIB_OPKS_PATH/package/pcsx4all/Config.in"
	source "$BR2_EXTERNAL_OD_CONTRIB_OPKS_PATH/package/pocketsnes/Config.in"

comment "Frontends"
	source "$BR2_EXTERNAL_OD_CONTRIB_OPKS_PATH/package/esoteric/Config.in"

comment "Games"
	source "$BR2_EXTERNAL_OD_CONTRIB_OPKS_PATH/package/blockattack/Config.in"
	source "$BR2_EXTERNAL_OD_CONTRIB_OPKS_PATH/package/devilutionx/Config.in"
	source "$BR2_EXTERNAL_OD_CONTRIB_OPKS_PATH/package/ghouls-and-ghosts-remix/Config.in"
	source "$BR2_EXTERNAL_OD_CONTRIB_OPKS_PATH/package/hocoslamfy/Config.in"

comment "Applications"
	source "$BR2_EXTERNAL_OD_CONTRIB_OPKS_PATH/package/commander/Config.in"
```

## package/commander/Config.in
```kconfig
config BR2_PACKAGE_COMMANDER
	bool "commander"
	select BR2_PACKAGE_SDL
	select BR2_PACKAGE_SDL_GFX
	select BR2_PACKAGE_SDL_IMAGE
	select BR2_PACKAGE_SDL_TTF
	help
	  Two-pane file manager in the style of Norton Commander.

	  https://github.com/glebm/rs97-commander/

if BR2_PACKAGE_COMMANDER

config BR2_PACKAGE_COMMANDER_FONTS
	string "Font stack"
	default "{\"/usr/share/fonts/dejavu/DejaVuSansCondensed.ttf\",10},{\"/usr/share/fonts/truetype/droid/DroidSansFallback.ttf\",9}"

config BR2_PACKAGE_COMMANDER_FONTS_LOW_DPI
	string "Font stack for low DPI displays"
	default "{RES_DIR\"Fiery_Turk.ttf\",8},{\"/usr/share/fonts/dejavu/DejaVuSansCondensed.ttf\",10},{\"/usr/share/fonts/truetype/droid/DroidSansFallback.ttf\",9}"

config BR2_PACKAGE_COMMANDER_AUTOSCALE
	bool "Enable automatic screen size and PPU detection"
	default y

config BR2_PACKAGE_COMMANDER_WIDTH
	string "Screen width"
	help
	  Commander will pick the best resolution by default as reported by SDL.
	  This is unreliable on older kernels.
	  Use this and the HEIGHT option to force a different one.

config BR2_PACKAGE_COMMANDER_HEIGHT
	string "Screen height"

config BR2_PACKAGE_COMMANDER_PPU_X
	string "Horizontal pixels per unit"

config BR2_PACKAGE_COMMANDER_PPU_Y
	string "Vertical pixels per unit"

config BR2_PACKAGE_COMMANDER_OPK_NAME
	string "OPK file name (before the .opk extension)"

endif
```

## package/devilutionx/Config.in
```kconfig
config BR2_PACKAGE_DEVILUTIONX
	bool "DevilutionX"
	select BR2_PACKAGE_SDL
	select BR2_PACKAGE_SDL_IMAGE
	select BR2_PACKAGE_SDL_TTF
	select BR2_PACKAGE_SDL_MIXER
	help
	  Diablo 1.

	  https://github.com/diasurgical/devilutionX/
```

## package/fb-alpha/Config.in
```kconfig
config BR2_PACKAGE_FB_ALPHA
	bool "fba"
	select BR2_PACKAGE_LIBPNG
	select BR2_PACKAGE_SDL
	select BR2_PACKAGE_SDL_IMAGE
	select BR2_PACKAGE_ZLIB
	help
	  FB Alpha Emulator
```

## package/ghouls-and-ghosts-remix/Config.in
```kconfig
config BR2_PACKAGE_GHOULS_AND_GHOSTS_REMIX
	bool "ghouls-and-ghosts-remix"
	depends on BR2_PACKAGE_ALLEGRO
	help
	  Ghouls 'n Ghosts Remix
```

## package/glutexto/Config.in
```kconfig
config BR2_PACKAGE_GLUTEXTO
	bool "glutexto"
	select BR2_PACKAGE_SDL
	select BR2_PACKAGE_SDL_MIXER
	select BR2_PACKAGE_SDL_IMAGE
	select BR2_PACKAGE_SDL_TTF
	select BR2_PACKAGE_SPARROW3D
	help
	  A simple text editor.

	  https://github.com/theZiz/glutexto
```

## package/pocketsnes/Config.in
```kconfig
config BR2_PACKAGE_POCKETSNES
	bool "PocketSNES"
	select BR2_PACKAGE_DEJAVU
	select BR2_PACKAGE_LIBPNG
	select BR2_PACKAGE_SDL
	select BR2_PACKAGE_SDL_TTF
	help
	  PocketSNES emulator package
	  https://github.com/soarqin/PocketSNES
```
